## Kconfig
```kconfig
config ZMK_BEHAVIOR_MORSE
    bool
    default y
    depends on DT_HAS_ZMK_BEHAVIOR_MORSE_ENABLED

config ZMK_BEHAVIOR_CEASAR
    bool
    default y
    depends on DT_HAS_ZMK_BEHAVIOR_CEASAR_ENABLED

config ZMK_BEHAVIOR_NOISE
    bool
    default y
    depends on DT_HAS_ZMK_BEHAVIOR_NOISE_ENABLED
    
config ZMK_BEHAVIOR_IR_TV
    bool
    default y
    depends on DT_HAS_ZMK_BEHAVIOR_IR_TV_ENABLED
```

## dts/bindings/behaviors/zmk,behavior-ir-tv.yaml
```yaml
# Copyright (c) 2020 The ZMK Contributors
# SPDX-License-Identifier: MIT

description: IR Tv Power Behavior

compatible: "zmk,behavior-ir-tv"

include: zero_param.yaml # Additional parameters
```
