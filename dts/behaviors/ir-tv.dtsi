/*
 * Copyright (c) 2020 The ZMK Contributors
 *
 * SPDX-License-Identifier: MIT
 */


#include <dt-bindings/zmk/behaviors.h>
#include <dt-bindings/zmk/keys.h>

/ {
    behaviors {
#if ZMK_BEHAVIOR_OMIT(IR_TV)
        /omit-if-no-ref/
#endif
        ir_tv: ir_tv {
            compatible = "zmk,behavior-ir-tv";
            #binding-cells = <0>;
            display-name = "ir_tv";
        };
    };
};

